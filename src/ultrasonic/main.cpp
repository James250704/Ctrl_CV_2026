// ============================================================================
// 超音波 — 獨立 US-100 感測器節點 (RP2040 / Pico)
//
// 透過 PIO 以 GPIO Trigger/Echo 模式讀取 6 顆 US-100 超音波感測器。
// 將濾波後的距離數據與對位狀態透過 USB Serial 傳送至 Jetson。
//
// 硬體佈局（根據規格書）：
//   前方：2 顆感測器 (frontL, frontR) — 面向正前方
//   左側：2 顆感測器 (left1 在前, left2 在後) — 面向左側
//   右側：2 顆感測器 (right1 在前, right2 在後) — 面向右側
//
// 串音避免：分組輪詢
//   Group A (PIO0 SM0/1/2)：frontL, left1, right1 — 同時觸發
//   Group B (PIO0 SM3 + PIO1 SM0/1)：frontR, left2, right2 — A 完成後觸發
//
// 濾波：
//   每顆感測器使用 MEDIAN_WINDOW 筆原始資料的滑動中位數
//
// 對位計算：
//   frontDiff   = frontL_dist - frontR_dist   (0 表示與前方牆壁平行)
//   leftDiff    = left1_dist - left2_dist     (0 表示與左側牆壁平行)
//   rightDiff   = right1_dist - right2_dist   (0 表示與右側牆壁平行)
//
// USB Serial (CDC ACM) 輸出，115200 baud：
//   "US:FL=123,FR=120,L1=45,L2=48,R1=52,R2=55,FD=-3,LD=3,RD=-3\n"
//
// 時間預算：
//   Group A 觸發+等待回音 ≈ 30ms，Group B ≈ 30ms，計算+序列埠 ≈ 5ms
//   總週期 ≈ 65ms → 約 15Hz 輸出頻率。
// ============================================================================

#include "ultrasonic_echo.pio.h" // Generated by pioasm from .pio file
#include <Arduino.h>
#include <hardware/clocks.h>
#include <hardware/pio.h>

// ============================================================================
// US-100 常數
// ============================================================================
static constexpr uint32_t TRIGGER_PULSE_US = 12U;   // 最少 10 us（依資料表）
static constexpr uint32_t ECHO_TIMEOUT_US = 30000U; // 30 ms ~ 最大距離約 5 公尺
static constexpr uint32_t ECHO_MIN_WAIT_US = 400U;  // 感測器需約 300 us 啟動

// ============================================================================
// 距離校準偏移
// 實測診斷：這顆 US-100 是 active-LOW 觸發，且距離有固定 +~35mm 偏移
//   （量內部換能器膜片，非外殼前沿）。單顆測試用 45mm（使用者自訂）。
//   正式版先沿用單顆測試校正值；若裝上車體後對位誤差明顯，再實測重新校正。
// ============================================================================
static constexpr int32_t DIST_OFFSET_MM =
    45; // 感測器距離 - 實際距離 的固定偏移

// ============================================================================
// GPIO 腳位定義 — 6 顆 US-100 以 GPIO Trigger/Echo 模式運作
//
// 腳位編號：GPxx = Pico 板上的實體腳位
// ============================================================================

// --- 前方感測器（面向前方）---
static constexpr uint8_t PIN_TRIG_FRONT_LEFT = 2;  // GP6  = Pin 12  | Trigger
static constexpr uint8_t PIN_ECHO_FRONT_LEFT = 3;  // GP7  = Pin 13  | Echo
static constexpr uint8_t PIN_TRIG_FRONT_RIGHT = 4; // GP8  = Pin 14  | Trigger
static constexpr uint8_t PIN_ECHO_FRONT_RIGHT = 5; // GP9  = Pin 15  | Echo

// --- 左側感測器（面向左方）---
static constexpr uint8_t PIN_TRIG_LEFT_1 =
    10;                                        // GP10 = Pin 16  | Trigger (front)
static constexpr uint8_t PIN_ECHO_LEFT_1 = 11; // GP11 = Pin 17  | Echo (front)
static constexpr uint8_t PIN_TRIG_LEFT_2 =
    12;                                        // GP12 = Pin 18  | Trigger (rear)
static constexpr uint8_t PIN_ECHO_LEFT_2 = 13; // GP13 = Pin 19  | Echo (rear)

// --- 右側感測器（面向右方）---
static constexpr uint8_t PIN_TRIG_RIGHT_1 =
    14;                                         // GP14 = Pin 20  | Trigger (front)
static constexpr uint8_t PIN_ECHO_RIGHT_1 = 15; // GP15 = Pin 21  | Echo (front)
static constexpr uint8_t PIN_TRIG_RIGHT_2 =
    16;                                         // GP16 = Pin 22  | Trigger (rear)
static constexpr uint8_t PIN_ECHO_RIGHT_2 = 17; // GP17 = Pin 23  | Echo (rear)

// ============================================================================
// 感測器索引列舉與分組
// ============================================================================
enum SensorId : uint8_t {
    SENSOR_FRONT_LEFT = 0,  // Group A — PIO0 SM0
    SENSOR_LEFT_1 = 1,      // Group A — PIO0 SM1
    SENSOR_RIGHT_1 = 2,     // Group A — PIO0 SM2
    SENSOR_FRONT_RIGHT = 3, // Group B — PIO0 SM3
    SENSOR_LEFT_2 = 4,      // Group B — PIO1 SM0
    SENSOR_RIGHT_2 = 5,     // Group B — PIO1 SM1
    SENSOR_COUNT = 6
};

enum SensorGroup : uint8_t {
    GROUP_A = 0, // frontL,  left1, right1
    GROUP_B = 1  // frontR, left2, right2
};

// 每顆感測器的描述 — .bss 分配，無堆疊使用
struct SensorConfig {
    SensorId id;
    SensorGroup group;
    PIO pio; // pio0 or pio1
    uint sm; // SM index within the PIO block
    uint8_t trigPin;
    uint8_t echoPin;
    uint pioOffset; // Program offset in the PIO block
};

static const SensorConfig sensorConfigs[SENSOR_COUNT] = {
    // ---- Group A ----
    {SENSOR_FRONT_LEFT, GROUP_A, pio0, 0, PIN_TRIG_FRONT_LEFT,
     PIN_ECHO_FRONT_LEFT, 0},
    {SENSOR_LEFT_1, GROUP_A, pio0, 1, PIN_TRIG_LEFT_1, PIN_ECHO_LEFT_1, 0},
    {SENSOR_RIGHT_1, GROUP_A, pio0, 2, PIN_TRIG_RIGHT_1, PIN_ECHO_RIGHT_1, 0},

    // ---- Group B ----
    {SENSOR_FRONT_RIGHT, GROUP_B, pio0, 3, PIN_TRIG_FRONT_RIGHT,
     PIN_ECHO_FRONT_RIGHT, 0},
    {SENSOR_LEFT_2, GROUP_B, pio1, 0, PIN_TRIG_LEFT_2, PIN_ECHO_LEFT_2, 0},
    {SENSOR_RIGHT_2, GROUP_B, pio1, 1, PIN_TRIG_RIGHT_2, PIN_ECHO_RIGHT_2, 0},
};

// ============================================================================
// 滑動中位數濾波器 — 每顆感測器一組
// ============================================================================
static constexpr int MEDIAN_WINDOW = 5; // 視窗大小（奇數以取得乾淨中位數）

struct MedianFilter {
    uint32_t buffer[MEDIAN_WINDOW];
    int writeIdx;
    int count;
};

static MedianFilter g_median[SENSOR_COUNT];

static void medianInsert(int idx, uint32_t rawCount) {
    MedianFilter *mf = &g_median[idx];
    mf->buffer[mf->writeIdx] = rawCount;
    mf->writeIdx = (mf->writeIdx + 1) % MEDIAN_WINDOW;
    if(mf->count < MEDIAN_WINDOW)
        mf->count++;
}

static uint32_t medianGet(int idx) {
    MedianFilter *mf = &g_median[idx];
    if(mf->count == 0)
        return 0;

    // 複製並排序（插入排序，N=5 很快）
    uint32_t tmp[MEDIAN_WINDOW] = {};
    int n = mf->count;
    for(int i = 0; i < n; i++)
        tmp[i] = mf->buffer[i];

    for(int i = 1; i < n; i++) {
        uint32_t key = tmp[i];
        int j = i - 1;
        while(j >= 0 && tmp[j] > key) {
            tmp[j + 1] = tmp[j];
            j--;
        }
        tmp[j + 1] = key;
    }

    return tmp[n / 2]; // 中位數元素
}

// ============================================================================
// PIO 程式偏移
// ============================================================================
static uint g_pio0Offset = 0;
static uint g_pio1Offset = 0;

// ============================================================================
// 距離轉換
//
// PIO SM 以 F_SYS = 125 MHz（8 ns/週期）運作。
// 每次迴圈迭代 = 2 個 PIO 週期 = 16 ns。
// 回音脈衝寬度 = count * 16 ns。
// 距離 (mm) = 脈衝寬度 * 343,000 mm/s / 2
//           = count * 2 * 16 * 1e-9 * 343,000 / 2
//           = count * 343 / 125000
// 30 ms 回音的最大計數：約 1,875,000 < 2^31，uint32 安全。
// ============================================================================
static uint32_t rawCountToMm(uint32_t count) {
    // d_mm = count * 343 / 125000（先算原始距離 mm，再扣校準偏移）
    const int32_t mm = static_cast<int32_t>(
        (static_cast<uint64_t>(count) * 343ULL) / 125000ULL);
    const int32_t corrected = mm - DIST_OFFSET_MM;
    return (corrected > 0) ? static_cast<uint32_t>(corrected) : 0;
}

// ============================================================================
// 每顆感測器的量測狀態
// ============================================================================
static uint32_t g_rawCount[SENSOR_COUNT];
static uint32_t g_distanceMm[SENSOR_COUNT];
static bool g_valid[SENSOR_COUNT];

// ============================================================================
// 分組觸發 — active-LOW 觸發。
// 已診斷確認：這顆 US-100 的 Trigger 是「閒置 HIGH、拉 LOW」觸發
//   （電表量 Trigger pad 斷開時閒置 3.3V；手動拉 LOW 才回 Echo）。
// 故此處：將 TRIG 腳拉到 LOW，等 12us，再回 HIGH。
// ============================================================================
static void fireGroupTrigger(SensorGroup group) {
    for(int i = 0; i < SENSOR_COUNT; i++) {
        if(sensorConfigs[i].group == group)
            digitalWrite(sensorConfigs[i].trigPin, LOW); // 拉 LOW 觸發
    }

    delayMicroseconds(TRIGGER_PULSE_US);

    for(int i = 0; i < SENSOR_COUNT; i++) {
        if(sensorConfigs[i].group == group)
            digitalWrite(sensorConfigs[i].trigPin, HIGH); // 回閒置 HIGH
    }
}

// ============================================================================
// 重新啟動分組 PIO SM（解除 pull block）
// ============================================================================
static void rearmGroupSMs(SensorGroup group) {
    for(int i = 0; i < SENSOR_COUNT; i++) {
        if(sensorConfigs[i].group == group)
            ultrasonic_echo_trigger(sensorConfigs[i].pio, sensorConfigs[i].sm);
    }
}

// ============================================================================
// 輪詢分組內所有 SM 的 PIO RX FIFO
// ============================================================================
static void collectGroupResults(SensorGroup group) {
    // 30ms 的超時截止時間
    uint64_t deadline = time_us_64() + ECHO_TIMEOUT_US;
    bool done[SENSOR_COUNT] = {false};

    while(time_us_64() < deadline) {
        bool allDone = true;

        for(int i = 0; i < SENSOR_COUNT; i++) {
            if(sensorConfigs[i].group != group)
                continue;
            if(done[i])
                continue;

            // 既然沒 done，代表還在等這顆感測器的數據
            allDone = false;

            // 直接用 SDK 底層巨集檢查 RX FIFO 是否有東西
            if(!pio_sm_is_rx_fifo_empty(sensorConfigs[i].pio,
                                        sensorConfigs[i].sm)) {
                // 直接讀取，不透過封裝函式，避免指標傳遞錯誤
                uint32_t val =
                    pio_sm_get(sensorConfigs[i].pio, sensorConfigs[i].sm);

                if(val == 0) { // PIO 丟出 0 代表 PIO 自檢超時
                    g_rawCount[i] = 0;
                    g_valid[i] = false;
                } else {
                    g_rawCount[i] = val;
                    g_valid[i] = true;
                }
                done[i] = true;
            }
        }

        // 如果分組內所有需要的感測器都收到數據了，立刻提早結束，不浪費時間
        if(allDone)
            return;

        // 關鍵：將原本的 delayMicroseconds(50) 縮短到 2 微秒或拿掉
        // 讓 C++ 以極高頻率盯緊 FIFO，才不會錯過時序
        delayMicroseconds(2);
    }

    // 超過 30ms 截止時間仍有感測器沒回應
    for(int i = 0; i < SENSOR_COUNT; i++) {
        if(!done[i] && sensorConfigs[i].group == group) {
            g_rawCount[i] = 0;
            g_valid[i] = false;

            // 【重要】不要隨便呼叫 pio_sm_restart，清空 FIFO 緩衝區即可
            pio_sm_clear_fifos(sensorConfigs[i].pio, sensorConfigs[i].sm);
        }
    }
}

// ============================================================================
// 全部 6 顆感測器的一個完整量測週期
// ============================================================================
static void doMeasurementCycle() {
    // ---- Phase 1: Group A ----
    rearmGroupSMs(GROUP_A); // 1. 釋放 PIO 的 pull 阻塞，讓 PIO 開始準備監聽
    fireGroupTrigger(
        GROUP_A);                 // 2. 立刻發射 Trigger 脈衝！D1 Mini 收到會秒回 Echo
    collectGroupResults(GROUP_A); // 3. 收集結果

    // ---- Phase 2: Group B ----
    rearmGroupSMs(GROUP_B);
    fireGroupTrigger(GROUP_B);
    collectGroupResults(GROUP_B);

    // 更新中位數濾波器
    for(int i = 0; i < SENSOR_COUNT; i++) {
        if(g_valid[i] && g_rawCount[i] > 0) {
            medianInsert(i, g_rawCount[i]);
            g_distanceMm[i] = rawCountToMm(medianGet(i));
        }
    }
}

// ============================================================================
// 對位計算
//
// frontDiff = FL_dist - FR_dist   (正值 => 左側較近)
// leftDiff  = L1_dist  - L2_dist  (正值 => 前方左側較近)
// rightDiff = R1_dist  - R2_dist  (正值 => 前方右側較近)
//
// 全部接近 0 表示機器人與周圍牆壁平行。
// ============================================================================
struct AlignmentStatus {
    int16_t frontDiff;
    int16_t leftDiff;
    int16_t rightDiff;
    bool frontValid;
    bool leftValid;
    bool rightValid;
};

static AlignmentStatus computeAlignment() {
    AlignmentStatus align;
    align.frontDiff = static_cast<int16_t>(g_distanceMm[SENSOR_FRONT_LEFT]) -
                      static_cast<int16_t>(g_distanceMm[SENSOR_FRONT_RIGHT]);
    align.leftDiff = static_cast<int16_t>(g_distanceMm[SENSOR_LEFT_1]) -
                     static_cast<int16_t>(g_distanceMm[SENSOR_LEFT_2]);
    align.rightDiff = static_cast<int16_t>(g_distanceMm[SENSOR_RIGHT_1]) -
                      static_cast<int16_t>(g_distanceMm[SENSOR_RIGHT_2]);

    align.frontValid =
        g_valid[SENSOR_FRONT_LEFT] && g_valid[SENSOR_FRONT_RIGHT];
    align.leftValid = g_valid[SENSOR_LEFT_1] && g_valid[SENSOR_LEFT_2];
    align.rightValid = g_valid[SENSOR_RIGHT_1] && g_valid[SENSOR_RIGHT_2];
    return align;
}

// ============================================================================
// USB Serial 輸出
//
// 格式："US:FL=123,FR=120,L1=45,L2=48,R1=52,R2=55,FD=-3,LD=3,RD=-3\n"
// 標籤：FL/FR = 前左/前右，L1/L2 = 左-1/左-2，R1/R2 = 右-1/右-2
//        FD = 前方差值，LD = 左側差值，RD = 右側差值
//        "---" = 感測器無效，"--" = 對位資訊不可用
// ============================================================================
static void sendSerialPacket() {
    AlignmentStatus align = computeAlignment();
    char buf[128];
    int pos = 0;

    pos += snprintf(buf + pos, sizeof(buf) - static_cast<size_t>(pos), "US:");

    // 依序輸出：FL, FR, L1, L2, R1, R2
    static constexpr int sensorOrder[] = {SENSOR_FRONT_LEFT, SENSOR_FRONT_RIGHT,
                                          SENSOR_LEFT_1, SENSOR_LEFT_2,
                                          SENSOR_RIGHT_1, SENSOR_RIGHT_2};
    static const char *sensorLabels[] = {"FL", "FR", "L1", "L2", "R1", "R2"};

    for(int i = 0; i < SENSOR_COUNT; i++) {
        int idx = sensorOrder[i];
        if(g_valid[idx] && g_distanceMm[idx] > 0) {
            pos += snprintf(buf + pos, sizeof(buf) - static_cast<size_t>(pos),
                            "%s=%lu", sensorLabels[i],
                            static_cast<unsigned long>(g_distanceMm[idx]));
        } else {
            pos += snprintf(buf + pos, sizeof(buf) - static_cast<size_t>(pos),
                            "%s=---", sensorLabels[i]);
        }
        if(i < SENSOR_COUNT - 1)
            buf[pos++] = ',';
    }

    // 對位欄位
    buf[pos++] = ',';
    if(align.frontValid)
        pos += snprintf(buf + pos, sizeof(buf) - static_cast<size_t>(pos),
                        "FD=%d", static_cast<int>(align.frontDiff));
    else
        pos += snprintf(buf + pos, sizeof(buf) - static_cast<size_t>(pos),
                        "FD=--");

    buf[pos++] = ',';
    if(align.leftValid)
        pos += snprintf(buf + pos, sizeof(buf) - static_cast<size_t>(pos),
                        "LD=%d", static_cast<int>(align.leftDiff));
    else
        pos += snprintf(buf + pos, sizeof(buf) - static_cast<size_t>(pos),
                        "LD=--");

    buf[pos++] = ',';
    if(align.rightValid)
        pos += snprintf(buf + pos, sizeof(buf) - static_cast<size_t>(pos),
                        "RD=%d", static_cast<int>(align.rightDiff));
    else
        pos += snprintf(buf + pos, sizeof(buf) - static_cast<size_t>(pos),
                        "RD=--");

    buf[pos++] = '\n';
    buf[pos] = '\0';

    Serial.write(reinterpret_cast<const uint8_t *>(buf),
                 static_cast<size_t>(pos));
    Serial.flush();
}

// ============================================================================
// setup()
// ============================================================================
void setup() {
    // 1. USB Serial
    Serial.begin(115200);
    while(!Serial) {
        tight_loop_contents();
    }

    // 2. 初始化 trigger/echo GPIO
    //    這顆 US-100 是 active-LOW 觸發 → Trigger 閒置 HIGH、觸發時拉 LOW。
    //    Echo 的輸出閒置 LOW，INPUT_PULLDOWN 不會干擾；
    //    未接的 Echo 腳設為 INPUT_PULLDOWN 防浮接被相鄰 Trigger 耦合觸發。
    for(int i = 0; i < SENSOR_COUNT; i++) {
        pinMode(sensorConfigs[i].trigPin, OUTPUT);
        digitalWrite(sensorConfigs[i].trigPin,
                     HIGH); // 閒置 HIGH（active-low 觸發）
        pinMode(sensorConfigs[i].echoPin, INPUT_PULLDOWN);
    }

    // 3. 載入 PIO 程式
    //    PIO0：SM0=FL, SM1=L1, SM2=R1, SM3=FR
    //    PIO1：SM0=L2, SM1=R2
    g_pio0Offset = pio_add_program(pio0, &ultrasonic_echo_program);
    pio_sm_claim(pio0, 0);
    pio_sm_claim(pio0, 1);
    pio_sm_claim(pio0, 2);
    pio_sm_claim(pio0, 3);

    g_pio1Offset = pio_add_program(pio1, &ultrasonic_echo_program);
    pio_sm_claim(pio1, 0);
    pio_sm_claim(pio1, 1);

    // 4. 使用正確的 echo 腳位初始化每個 SM
    for(int i = 0; i < SENSOR_COUNT; i++) {
        const SensorConfig &cfg = sensorConfigs[i];
        // 使用 pio_add_program() 回傳的實際偏移量（非 cfg.pioOffset，因 const
        // 陣列恆為 0）
        uint offset = (cfg.pio == pio0) ? g_pio0Offset : g_pio1Offset;
        ultrasonic_echo_program_init(cfg.pio, cfg.sm, offset, cfg.echoPin);
    }

    // 5. 以初始量測值填充中位數緩衝區
    // for(int seed = 0; seed < MEDIAN_WINDOW; seed++) {
    //     doMeasurementCycle();
    //     delay(10);
    // }

    // 6. LED 閃爍表示就緒
    pinMode(LED_BUILTIN, OUTPUT);
    digitalWrite(LED_BUILTIN, HIGH);
}

// ============================================================================
// loop()
// ============================================================================
void loop() {
    doMeasurementCycle();
    sendSerialPacket();
    delay(5);
}

// ============================================================================
// Core 1：未使用
// ============================================================================
void setup1() { /* unused */ }
void loop1() { /* unused */ }
